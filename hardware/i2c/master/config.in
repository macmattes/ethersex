## hardware/i2c/master/config.in
```kconfig
dep_bool_menu "I2C master" I2C_MASTER_SUPPORT "$(not $I2C_SLAVE_SUPPORT)" $ARCH_AVR
  if [ "$I2C_MASTER_SUPPORT" = "y" ]; then
    int "I2C master baudrate in kHz" CONF_I2C_BAUD 400
  fi
  dep_bool "I2C detection support" I2C_DETECT_SUPPORT $I2C_MASTER_SUPPORT
  dep_bool "I2C generic read/write support" I2C_GENERIC_SUPPORT $I2C_MASTER_SUPPORT
  if [ "$I2C_GENERIC_SUPPORT" = "y" ]; then
    dep_bool "  Add delays for slow devices" I2C_GENERIC_DELAYS $I2C_GENERIC_SUPPORT
  fi
  dep_bool "I2C EEPROM (24cxx) support" I2C_24CXX_SUPPORT $I2C_MASTER_SUPPORT
  if [ "$I2C_24CXX_SUPPORT" = "y" ]; then
    int "I2C 24CXX Pagesize" CONF_I2C_24CXX_PAGESIZE 128
  fi
  dep_bool "I2C LM75   temperature sensor" I2C_LM75_SUPPORT $I2C_MASTER_SUPPORT
  dep_bool "I2C TMP175 temperature sensor" I2C_TMP175_SUPPORT $I2C_MASTER_SUPPORT
  dep_bool "I2C DS1631 temperature sensor" I2C_DS1631_SUPPORT $I2C_MASTER_SUPPORT
  dep_bool "I2C DS13X7  RTC" I2C_DS13X7_SUPPORT $I2C_MASTER_SUPPORT
  if [ "$I2C_DS13X7_SUPPORT" = "y" ]; then
    choice 'RTC Type'       \
           "DS1307  DS1307  \
            DS1337  DS1337" \
           'DS1307' I2C_DS13X7_TYPE
  fi
  dep_bool "I2C PCF8583 RTC" I2C_PCF8583_SUPPORT $I2C_MASTER_SUPPORT
  if [ "$I2C_PCF8583_SUPPORT" = "y" ]; then
    dep_bool "  Pin A0 on Vcc" I2C_PCF8583_A0_VCC $I2C_PCF8583_SUPPORT
    dep_bool "  Sync system clock" I2C_PCF8583_SYNC $I2C_PCF8583_SUPPORT
    if [ "$I2C_PCF8583_SYNC" = "y" ]; then
      int "  Sync period in sec" I2C_PCF8583_SYNC_PERIOD 60 $I2C_PCF8583_SYNC
    fi
  fi
  dep_bool "I2C TSL2550 light sensor" I2C_TSL2550_SUPPORT $I2C_MASTER_SUPPORT
  dep_bool "I2C TSL2561 light sensor" I2C_TSL2561_SUPPORT $I2C_MASTER_SUPPORT
  dep_bool "I2C BH1750 light sensor"  I2C_BH1750_SUPPORT  $I2C_MASTER_SUPPORT
  dep_bool "I2C TCS3414CS DIGITAL COLOR LIGHT SENSOR"  I2C_TCS3414CS_SUPPORT  $I2C_MASTER_SUPPORT
  if [ "$I2C_TCS3414CS_SUPPORT" = "y" ]; then
    choice '   TCS3414CS GAIN VALUE' \
           "1    GAIN_1              \
            4    GAIN_4              \
	    16   GAIN_16             \
            64   GAIN_64"            \
           '1' I2C_TCS3414CS_GAIN
    choice '    TCS3414CS Prescaler' \
           "1    PRESCALER_1         \
            2    PRESCALER_2         \
            4    PRESCALER_4         \
            8    PRESCALER_8         \
            16    PRESCALER_16       \
            32    PRESCALER_32       \
            64    PRESCALER_64"      \
           '4' I2C_TCS3414CS_PRESCALER
    choice '  TCS3414CS INTEGRATION TIME' 	\
           "12    INTEGRATION_TIME_12ms         \
            100   INTEGRATION_TIME_100ms        \
            400   INTEGRATION_TIME_400ms"       \
           '12' I2C_TCS3414CS_INTEGRATION_TIME
    dep_bool "  Calculation Support" I2C_TCS3414CS_CALC_SUPPORT $I2C_TCS3414CS_CALC_SUPPORT
  fi

  dep_bool "I2C BMP085 barometric pressure sensor" I2C_BMP085_SUPPORT $I2C_MASTER_SUPPORT
  if [ "$I2C_BMP085_SUPPORT" = "y" ]; then
    dep_bool "  BMP085 advanced barometric calculations" I2C_BMP085_BAROCALC_SUPPORT $I2C_MASTER_SUPPORT
    choice '    BMP085 Pressure Oversampling' \
           "0    BMP085_OSS_0                 \
            1    BMP085_OSS_1                 \
            2    BMP085_OSS_2                 \
            3    BMP085_OSS_3"                \
           '3' I2C_BMP085_OVERSAMPLING
  fi

  dep_bool "I2C PCA9531  8-bit LED dimmer" I2C_PCA9531_SUPPORT $I2C_MASTER_SUPPORT
  dep_bool "I2C PCA9685 12-bit LED dimmer" I2C_PCA9685_SUPPORT $I2C_MASTER_SUPPORT
  dep_bool "I2C PCF8574X 8-bit port extension" I2C_PCF8574X_SUPPORT $I2C_MASTER_SUPPORT
  dep_bool "I2C PCA9555 16-bit port extension" I2C_PCA9555_SUPPORT $I2C_MASTER_SUPPORT
  dep_bool "I2C MAX7311 16-bit port extension" I2C_MAX7311_SUPPORT $I2C_MASTER_SUPPORT
  dep_bool "I2C MCP4725 DAC" I2C_MCP4725_SUPPORT $I2C_MASTER_SUPPORT
  if [ "$I2C_MCP4725_SUPPORT" = "y" ]; then
    choice '    MCP4725 Address' \
           "Lo    0x62                 \
            Hi    0x63"                \
           'Lo' I2C_MCP4725_ADDRESS
  fi
  dep_bool "I2C to UDP gateway" I2C_UDP_SUPPORT $I2C_MASTER_SUPPORT $UDP_SUPPORT
  if [ "$I2C_UDP_SUPPORT" = "y" ]; then
    int "I2C to UDP gateway port" I2C_PORT 8995 $I2C_UDP_SUPPORT
  fi

  comment  "Debugging Flags"
  dep_bool "I2C" DEBUG_I2C $DEBUG $I2C_MASTER_SUPPORT

endmenu
```

## protocols/vaillant/config.in
```kconfig
usart_count_used
if [ "$VAILLANT_SUPPORT" = y -o $USARTS -gt $USARTS_USED ]; then
	dep_bool_menu "VAILLANT Support" VAILLANT_SUPPORT $ARCH_AVR
		choice '  VAILLANT usart select' "$(usart_choice VAILLANT)"
		usart_process_choice VAILLANT
		comment  "Debugging Flags"
		dep_bool 'VAILLANT' DEBUG_VAILLANT $DEBUG
	endmenu
else
	define_bool VAILLANT_SUPPORT n
	comment "VAILLANT not available. No free usart. ($USARTS_USED/$USARTS)"
fi
```
